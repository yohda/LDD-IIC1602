/dts-v1/;
/plugin/;

/ {
    compatible = "brcm,bcm2835";

    fragment@0 {
        target = <&i2c1>;
        __overlay__ {
			iic1602@27 {
        		compatible = "clcd,iic1602";
        		reg = <0x27>;
            
        		mode = <0>; /* 0: 4-bit 1: 8-bit */
            
        		pin-ctrl = /bits/ 8 <0 1 2>;    /* rs rw en */
        		pin-data = /bits/ 8 <4 5 6 7>;  /* 4-bit: D0~D7, 8-bit:D4~D7 */
        		pin-backlight = /bits/ 8 <3>;
            
        		display-columns = /bits/ 16 <2>; 
        		display-rows = /bits/ 16 <16>;
    		}; 		
        };
    };
};
